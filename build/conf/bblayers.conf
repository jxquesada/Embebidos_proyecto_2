## build/conf/bblayers.conf
```bitbake
# POKY_BBLAYERS_CONF_VERSION is increased each time build/conf/bblayers.conf
# changes incompatibly
POKY_BBLAYERS_CONF_VERSION = "2"

BBPATH = "${TOPDIR}"
BBFILES ?= ""

BBLAYERS ?= " \
  /home/reevan/Embebidos/poky-dunfell/meta \
  /home/reevan/Embebidos/poky-dunfell/meta-poky \
  /home/reevan/Embebidos/poky-dunfell/meta-yocto-bsp \
  /home/reevan/Embebidos/poky-dunfell/meta-openembedded/meta-oe \
  /home/reevan/Embebidos/poky-dunfell/meta-openembedded/meta-python \
  /home/reevan/Embebidos/poky-dunfell/meta-openembedded/meta-multimedia \
  /home/reevan/Embebidos/poky-dunfell/meta-openembedded/meta-networking \
  /home/reevan/Embebidos/poky-dunfell/meta-openembedded/meta-webserver \
  /home/reevan/Embebidos/poky-dunfell/meta-recmovly \
  /home/reevan/Embebidos/poky-dunfell/meta-multimedia \
  "
```

## meta-emociones/conf/layer.conf
```bitbake
# We have a conf and classes directory, add to BBPATH
BBPATH .= ":${LAYERDIR}"

# We have recipes-* directories, add to BBFILES
BBFILES += "${LAYERDIR}/recipes-*/*.bb \
            ${LAYERDIR}/recipes-*/*/*.bbappend"

BBFILE_COLLECTIONS += "meta-emociones"
BBFILE_PATTERN_meta-emociones = "^${LAYERDIR}/"
BBFILE_PRIORITY_meta-emociones = "6"

LAYERDEPENDS_meta-emociones = "core"
LAYERSERIES_COMPAT_meta-emociones = "dunfell"
```
